## boards/shields/hamboarder/Kconfig.shield
```kconfig
# Copyright (c) 2021 The ZMK Contributors
# SPDX-License-Identifier: MIT

config SHIELD_HAMBOARDER
    def_bool $(shields_list_contains,hamboarder)
```

## config/boards/shields/hamboarder/Kconfig.defconfig
```kconfig
# sets bluetooth name to hamboarder

if SHIELD_HAMBOARDER

config ZMK_KEYBOARD_NAME
    default "HAMBOARDER"

endif
```

## config/boards/shields/hamboarder/Kconfig.shield
```kconfig
# registers hamboarder as a valid shield

config SHIELD_HAMBOARDER
    def_bool $(shields_list_contains,hamboarder)
```

## config/west.yml
```yaml
manifest:
  remotes:
    - name: zmkfirmware
      url-base: https://github.com/zmkfirmware

  projects:
    - name: zmk
      remote: zmkfirmware
      revision: ada1542940c3a01c0866c9fe9c30f489bc087328
      import: app/west.yml

  self:
    path: config
```
